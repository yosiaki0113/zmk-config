#include <behaviors.dtsi>
#include <dt-bindings/zmk/bt.h>
#include <dt-bindings/zmk/keys.h>

/ {
    keymap {
        compatible = "zmk,keymap";

        /* レイヤー 0 (通常入力) */

        default_layer {
            bindings = <
&kp Q  &kp E  &kp R  &kp F  &kp SPACE  &kp N2  &kp N3  &lt 1 A
            >;
        };

        /* レイヤー 1 (機能拡張) */

        ble_layer {
            bindings = <
&kp N7  &kp I  &none  &none  &bt BT_CLR_ALL  &bt BT_SEL 0  &none  &trans
            >;
        };
    };
};
